/include/ "system-conf.dtsi"
/ {
	model = "Enclustra ME-XU5-5EV-3E-D13E SOM";
};
#include "zynqmp_enclustra_common.dtsi"
#include "zynqmp_enclustra_mercury_pe1.dtsi"
#include "zynqmp_enclustra_mercury_xu5.dtsi"
